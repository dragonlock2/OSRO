## firmware/main/Kconfig.projbuild
```kconfig
menu "OSRO configuration"
    config WIFI_IS_AP
        bool "Serve as an AP"
        default n
        help
            Serve as a connectable AP instead of a station

    if !WIFI_IS_AP
        choice WIFI_AUTH_MODE
            prompt "WiFi auth mode"
            default WIFI_AUTH_OPEN

            config WIFI_AUTH_OPEN
                bool "OPEN"
            config WIFI_AUTH_WPA2_PSK
                bool "WPA2 PSK"
            config WIFI_AUTH_WPA2_ENTERPRISE
                bool "WPA2 ENTERPRISE"
        endchoice
    endif

    config WIFI_SSID
        string "WiFi SSID"
        default "OSRO"
        help
            SSID (network name) to connect to.

    if WIFI_AUTH_WPA2_ENTERPRISE
        config WIFI_USERNAME
            string "WiFi Username"
            default "dragonlock2"
            help
                WiFi username to use
    endif

    if WIFI_IS_AP || WIFI_AUTH_WPA2_PSK || WIFI_AUTH_WPA2_ENTERPRISE
        config WIFI_PASSWORD
            string "WiFi Password"
            default "password"
            help
                WiFi password to use
    endif

    config WIFI_MDNS_HOSTNAME
        string "WiFi mDNS hostname"
        default "osro"
        help
            mDNS hostname (connect using <hostname>.local)

    config WIFI_MDNS_DEFAULT_INSTANCE
        string "WiFi mDNS default instance name"
        default "OSRO v1.0"
        help
            Friendly name for mDNS
endmenu
```

## firmware/sdkconfig.defaults
```kconfig
CONFIG_PARTITION_TABLE_CUSTOM=y
CONFIG_PARTITION_TABLE_CUSTOM_FILENAME="partitions.csv"
CONFIG_PARTITION_TABLE_FILENAME="partitions.csv"

CONFIG_SPIFFS_OBJ_NAME_LEN=64

CONFIG_ESP_CONSOLE_USB_SERIAL_JTAG=y
CONFIG_ESP_CONSOLE_SECONDARY_NONE=y

CONFIG_FREERTOS_HZ=1000
```
